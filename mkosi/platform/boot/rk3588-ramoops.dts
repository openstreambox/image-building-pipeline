/dts-v1/;
/plugin/;

/* Reference overlay for the equivalent U-Boot reservation in boot.scr.cmd.
 * No base-tree symbols needed. Do not apply both mechanisms. */
/ {
    fragment@0 {
        target-path = "/reserved-memory";
        __overlay__ {
            #address-cells = <2>;
            #size-cells = <2>;
            ranges;
            ramoops@1f000000 {
                compatible = "ramoops";
                reg = <0x0 0x1f000000 0x0 0x100000>;
                record-size = <0x20000>;
                console-size = <0x80000>;
                max-reason = <2>;
            };
        };
    };
};
